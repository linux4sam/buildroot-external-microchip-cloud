## Config.in
```kconfig
source "$BR2_EXTERNAL_GREENKEY_PATH/package/cryptoauthlib/Config.in"
source "$BR2_EXTERNAL_GREENKEY_PATH/package/libp11/Config.in"
```

## package/libp11/Config.in
```kconfig
config BR2_PACKAGE_LIBP11
	bool "libp11"
	depends on !BR2_STATIC_LIBS
	depends on BR2_USE_MMU
	depends on BR2_TOOLCHAIN_HAS_THREADS
	select BR2_PACKAGE_LIBTASN1
	help
      This code repository produces two libraries:
      
      libp11 provides a higher-level (compared to the PKCS#11 library) 
      interface to access PKCS#11 objects. It is designed to integrate with 
      applications that use OpenSSL.

      pkcs11 engine plugin for the OpenSSL library allows accessing PKCS#11
      modules in a semi-transparent way.

      The wiki page for this project is at https://github.com/OpenSC/libp11/wiki
      and includes a bug tracker and source browser.

      https://github.com/OpenSC/libp11
```
